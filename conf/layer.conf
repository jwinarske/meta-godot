## conf/layer.conf
```bitbake
# We have a conf and classes directory, append to BBPATH
BBPATH .= ":${LAYERDIR}"

BBFILES += "\
    ${LAYERDIR}/recipes*/*/*.bb \
    ${LAYERDIR}/recipes*/*/*.bbappend \
    ${LAYERDIR}/recipes*/*/*/*.bb \
    ${LAYERDIR}/recipes*/*/*/*.bbappend \
"

BBFILE_COLLECTIONS += "godot-layer"
BBFILE_PATTERN_godot-layer := "^${LAYERDIR}/"
BBFILE_PRIORITY_godot-layer = "12"

LAYERSERIES_COMPAT_godot-layer = "nanbield scarthgap"

LAYERDEPENDS_godot-layer = "clang-layer"

LAYERRECOMMENDS_godot-layer = " \
    gnome-layer \
"

BBFILES_DYNAMIC += " \
    gnome-layer:${LAYERDIR}/dynamic-layers/gnome-layer/*/*/*.bb \
    gnome-layer:${LAYERDIR}/dynamic-layers/gnome-layer/*/*/*/*.bb \
    gnome-layer:${LAYERDIR}/dynamic-layers/gnome-layer/*/*/*.bbappend \
"
```
